## Kconfig
```kconfig
# sentry-micro as an ESP-IDF component. Option names match the Zephyr module's
# (zephyr/Kconfig) wherever the option means the same thing, so a setting carries across.

menu "sentry-micro"

    config SENTRY_MICRO_SESSIONS
        bool "Sessions, for release health"
        default y
        help
            Count each boot as one session in Sentry's release health. The
            session opens at sentry_init() and is closed by the next boot from
            its reset reason: a panic, a watchdog or a brownout ends it as
            crashed, anything else as exited. Updates are sent by
            sentry_flush() once the device knows the date, because Sentry
            drops a session that is not dated; a build with no clock source
            never sends them. Needs a release in sentry_options_t.

            The record is kept beside the log ring in RTC memory, which
            survives a reset but not a power cycle. Logs and metrics are
            switched with the SENTRY_MICRO_LOGS_ENABLED and
            SENTRY_MICRO_METRICS_ENABLED defines rather than here.

    config SENTRY_MICRO_TRANSPORT_WIFI
        bool "WiFi transport: HTTPS straight to ingest"
        default y
        help
            POST envelopes to Sentry ingest over HTTPS through esp_http_client
            and ESP-TLS, with no host in between. Register it with
            sentry_wifi_transport_init() from
            <transport/esp-idf/sentry_transport_wifi.h>.

            Despite the name it is not tied to the radio: it sends over the
            interface lwIP routes through and is available whenever the
            default interface has an IPv4 address. The application owns the
            network: it brings WiFi (or Ethernet) up, and examples/idf_basic
            shows how.

            Never call it from a panic handler: the HTTP client and the TLS
            handshake allocate from the heap.

    config SENTRY_MICRO_WIFI_TLS_VERIFY
        bool "Verify ingest's TLS certificate"
        default y
        depends on SENTRY_MICRO_TRANSPORT_WIFI
        help
            Check that the server's certificate chains to a trusted root and
            names the ingest host. The root is DigiCert Global Root G2,
            bundled with sentry-micro, which Sentry's ingest certificate
            chains to; an application can pass its own root to
            sentry_wifi_transport_init() instead. Certificate dates are not
            checked unless MBEDTLS_HAVE_TIME_DATE is set, so this works before
            the clock is.

            The bundled root expires on 2038-01-15, and stops matching sooner
            if Sentry moves ingest to a certificate from another root. Either
            way every handshake then fails until the firmware carries a root
            that matches, so a fleet that cannot be updated should consider
            passing its own, or SENTRY_MICRO_WIFI_TLS_CRT_BUNDLE.

            Turn it off only to debug a handshake, or for an endpoint whose
            certificate cannot be verified. ESP-TLS then needs ESP_TLS_INSECURE
            and ESP_TLS_SKIP_SERVER_CERT_VERIFY as well, and the build stops
            until they are set. The connection is encrypted but not
            authenticated: anything on the path can pose as ingest and read
            the DSN key from the auth header. The transport logs a warning on
            its first send.

    config SENTRY_MICRO_WIFI_TLS_CRT_BUNDLE
        bool "Trust ESP-IDF's certificate bundle instead of the bundled root"
        default n
        depends on SENTRY_MICRO_WIFI_TLS_VERIFY && MBEDTLS_CERTIFICATE_BUNDLE
        help
            Verify ingest against ESP-IDF's bundle of common root certificates
            (esp_crt_bundle_attach) rather than the one DigiCert root
            sentry-micro carries. The bundle keeps working if Sentry changes
            certificate authority, at a cost of tens of KB of flash, set by
            the MBEDTLS_DEFAULT_CERTIFICATE_BUNDLE choice. A CA passed to
            sentry_wifi_transport_init() still takes precedence.

    config SENTRY_MICRO_WIFI_TIMEOUT_MS
        int "WiFi transport network timeout, in ms"
        default 10000
        range 1000 120000
        depends on SENTRY_MICRO_TRANSPORT_WIFI
        help
            esp_http_client's network timeout, applied to each step of a
            send: the connect and TLS handshake, each write of the request,
            and the wait for the response headers. Name resolution is bounded
            by lwIP instead.

endmenu
```

## zephyr/Kconfig
```kconfig
# sentry-micro on Zephyr.

menuconfig SENTRY_MICRO
	bool "sentry-micro, the Sentry SDK for microcontrollers"
	select HWINFO
	select ENTROPY_GENERATOR
	imply SYS_HEAP_RUNTIME_STATS
	imply XTENSA_ENABLE_BACKTRACE if XTENSA
	imply THREAD_NAME
	help
	  Report boots and errors to Sentry from a device with no Sentry
	  knowledge on the far side of its link. HWINFO supplies the reset
	  cause and the factory device id; the entropy driver mints event ids,
	  which must not collide across a fleet. Heap runtime statistics are
	  what the free-heap numbers on every event are read from; without
	  them those fields report 0.

	  On Xtensa the crash record's backtrace is walked with the kernel's
	  own backtrace code, which XTENSA_ENABLE_BACKTRACE compiles; without
	  it a crash reports the faulting PC only. Thread names are what a
	  crash reports as the thread that died; without THREAD_NAME that
	  field is empty. Each costs a little flash, and THREAD_NAME a few
	  bytes per thread.

if SENTRY_MICRO

config SENTRY_MICRO_TRANSPORT_SERIAL
	bool "Serial relay transport"
	default y
	depends on SERIAL
	help
	  Deliver envelopes through a host on the other end of a UART, using
	  the same @SENTRY-RELAY/1 protocol as the Arduino SerialTransport.
	  Run scripts/serial_relay.py on the host.

config SENTRY_MICRO_TRANSPORT_WIFI
	bool "WiFi transport: HTTPS straight to ingest"
	default y
	depends on WIFI && NET_IPV4 && NET_SOCKETS && NET_SOCKETS_SOCKOPT_TLS && DNS_RESOLVER
	imply MBEDTLS_PEM_PARSE_C
	imply MBEDTLS_SSL_SERVER_NAME_INDICATION
	help
	  POST envelopes to Sentry ingest over HTTPS, through Zephyr's TLS
	  sockets, with no host in between. Register it with
	  sentry_wifi_transport_init() from
	  <transport/zephyr/sentry_transport_wifi.h>.

	  The application's own configuration owns the network stack: WiFi,
	  IPv4, DHCP, sockets, DNS, TLS and the mbedTLS heap and record sizes
	  are all set there (examples/zephyr_basic/wifi.conf has a working
	  set), and this option only appears once they are. It does default
	  on two small mbedTLS features the transport cannot work without:
	  the PEM parser, because the bundled CA is PEM, and server name
	  indication (SNI), because ingest closes a handshake that does not
	  name the host it wants.

	  Never call it from a fatal-error handler: the TLS handshake
	  allocates from the mbedTLS heap.

config SENTRY_MICRO_WIFI_TLS_VERIFY
	bool "Verify ingest's TLS certificate"
	default y
	depends on SENTRY_MICRO_TRANSPORT_WIFI
	help
	  Check that the server's certificate chains to a trusted root and
	  names the ingest host. The root is DigiCert Global Root G2, bundled
	  with the module, which Sentry's ingest certificate chains to; an
	  application can pass its own root to sentry_wifi_transport_init()
	  instead. Certificate dates are not checked unless
	  MBEDTLS_HAVE_TIME_DATE is set, so this works before the clock is.

	  The bundled root expires on 2038-01-15, and stops matching sooner
	  if Sentry moves ingest to a certificate from another root. Either
	  way every handshake then fails until the firmware carries a root
	  that matches, so a fleet that cannot be updated should consider
	  passing its own.

	  Turn it off only to debug a handshake, or for an endpoint whose
	  certificate cannot be verified, such as a self-signed one on a
	  local network. The connection is then encrypted but not
	  authenticated: anything on the path can pose as ingest and read
	  the DSN key from the auth header. The transport logs a warning on
	  its first send.

config SENTRY_MICRO_WIFI_TIMEOUT_MS
	int "WiFi transport send and response timeout, in ms"
	default 10000
	depends on SENTRY_MICRO_TRANSPORT_WIFI
	help
	  Bounds writing the request and waiting for the response headers.
	  Resolving the host, connecting and the TLS handshake are bounded by
	  Zephyr's own NET_SOCKETS_DNS_TIMEOUT, NET_SOCKETS_CONNECT_TIMEOUT
	  and NET_SOCKETS_TLS_CONNECT_TIMEOUT.

config SENTRY_MICRO_WIFI_TLS_SEC_TAG
	int "TLS credential tag for the WiFi transport's CA"
	default 1397050964
	depends on SENTRY_MICRO_TRANSPORT_WIFI
	help
	  The security tag the CA certificate is registered under in Zephyr's
	  TLS credential store. Tags are shared by the whole application, so
	  the default is a number nothing else is likely to pick: it spells
	  "SENT" in ASCII (0x53454E54). Change it only if the application
	  already uses this value for a credential of its own.

config SENTRY_MICRO_FATAL_HANDLER
	bool "Record fatal errors for the next boot to report"
	default y
	help
	  Provide k_sys_fatal_error_handler(), overriding the kernel's weak
	  default. It stores the reason, the exception cause, the faulting
	  PC and a backtrace in memory that survives the reboot, marks the
	  reset as a panic on Espressif SoCs, and then does exactly what the
	  default does: reboot with RESET_ON_FATAL_ERROR, halt without it.
	  sentry_event_attach_coredump() reports the record on the next boot.

	  Only one k_sys_fatal_error_handler() can be linked. An application
	  that needs its own should say n here and call
	  sentry_zephyr_record_fatal() (platform/zephyr/sentry_coredump_zephyr.h)
	  first thing from its handler.

config SENTRY_MICRO_SERIAL_TIMEOUT_MS
	int "How long to wait for the serial relay to answer, in ms"
	default 15000
	depends on SENTRY_MICRO_TRANSPORT_SERIAL
	help
	  Covers the host's own DNS, TLS and round trip, so it is generous.
	  An unanswered request times out into "no route", which is what the
	  caller would act on anyway; the only cost of a long timeout is the
	  wait when no relay is running.

endif # SENTRY_MICRO

# Event timestamps and uptimes are 64-bit and formatted with %llu. Picolibc's default
# integer-only printf drops the "ll" and prints the wrong number with no error, so prefer the
# level that keeps it. A choice member cannot be selected; adding a default to the choice is
# how a module steers it. The float level carries long long too, and is what this resolves to
# when the FPU pulls in floating-point printf. sentry_device_zephyr.c refuses to build if
# neither ends up chosen.
if SENTRY_MICRO && PICOLIBC

choice PICOLIBC_IO_LEVEL
	default PICOLIBC_IO_LONG_LONG
endchoice

endif
```
