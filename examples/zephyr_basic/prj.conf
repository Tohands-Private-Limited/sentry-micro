## CMakeLists.txt
```
# sentry-micro — zephyr_basic
#
# The DSN and release come from the environment at configure time, the same way the
# PlatformIO examples take them (scripts/env_secrets.py), so nothing secret lives in a file.
# They are read when CMake configures: change one, rebuild with `-p always`.

cmake_minimum_required(VERSION 3.20.0)

# This repository is the module. Added before find_package(Zephyr), which is where modules
# are discovered; after it, the module is silently absent and CONFIG_SENTRY_MICRO is unknown.
get_filename_component(SENTRY_MICRO_ROOT ${CMAKE_CURRENT_LIST_DIR}/../.. ABSOLUTE)
list(APPEND ZEPHYR_EXTRA_MODULES ${SENTRY_MICRO_ROOT})

find_package(Zephyr REQUIRED HINTS $ENV{ZEPHYR_BASE})
project(sentry_micro_zephyr_basic)

target_sources(app PRIVATE src/main.c)

if(DEFINED ENV{SENTRY_MICRO_DSN} AND NOT "$ENV{SENTRY_MICRO_DSN}" STREQUAL "")
  target_compile_definitions(app PRIVATE "SENTRY_DSN=\"$ENV{SENTRY_MICRO_DSN}\"")
else()
  # Loud on purpose: a placeholder DSN builds and flashes fine, then reports to nowhere.
  message(WARNING "SENTRY_MICRO_DSN is not set; this build uses a placeholder DSN and "
                  "will not reach Sentry. Export it and rebuild with -p always.")
endif()

if(DEFINED ENV{SENTRY_MICRO_RELEASE} AND NOT "$ENV{SENTRY_MICRO_RELEASE}" STREQUAL "")
  target_compile_definitions(app PRIVATE "SENTRY_RELEASE=\"$ENV{SENTRY_MICRO_RELEASE}\"")
endif()

# WiFi credentials, from the environment like the DSN. Setting the SSID is what selects the
# WiFi transport over the serial relay; the network stack it needs comes from wifi.conf.
if(DEFINED ENV{SENTRY_MICRO_WIFI_SSID} AND NOT "$ENV{SENTRY_MICRO_WIFI_SSID}" STREQUAL "")
  if(NOT CONFIG_SENTRY_MICRO_TRANSPORT_WIFI)
    # Caught here rather than as an undefined sentry_wifi_transport_init() at link time.
    message(FATAL_ERROR "SENTRY_MICRO_WIFI_SSID is set, but this build has no WiFi stack. "
                        "Add -DEXTRA_CONF_FILE=wifi.conf after the -- of the west command.")
  endif()
  target_compile_definitions(app PRIVATE "WIFI_SSID=\"$ENV{SENTRY_MICRO_WIFI_SSID}\"")
  if(DEFINED ENV{SENTRY_MICRO_WIFI_PASSWORD} AND NOT "$ENV{SENTRY_MICRO_WIFI_PASSWORD}" STREQUAL "")
    target_compile_definitions(app PRIVATE
                               "WIFI_PASSWORD=\"$ENV{SENTRY_MICRO_WIFI_PASSWORD}\"")
  else()
    message(WARNING "SENTRY_MICRO_WIFI_PASSWORD is not set; this build joins the network as "
                    "an open one. Export it and rebuild with -p always if it is not.")
  endif()
elseif(CONFIG_SENTRY_MICRO_TRANSPORT_WIFI)
  # Loud for the same reason as the DSN: this builds, flashes and then never touches WiFi.
  message(WARNING "This build has the WiFi stack but SENTRY_MICRO_WIFI_SSID is not set, so it "
                  "reports over the serial relay. Export it and rebuild with -p always.")
endif()

# -DSENTRY_DEMO_CRASH=1 on the west/cmake command line: crash once after the boot event.
set(SENTRY_DEMO_CRASH 0 CACHE STRING "Crash deliberately after reporting the boot (0 or 1)")
target_compile_definitions(app PRIVATE SENTRY_DEMO_CRASH=${SENTRY_DEMO_CRASH})
```

## prj.conf
```kconfig
# sentry-micro — zephyr_basic

CONFIG_SENTRY_MICRO=y

# sentry_capture_message() builds the envelope in a 2 KB buffer on the caller's stack
# (SENTRY_MICRO_ENVELOPE_BUFFER_BYTES), and sentry_flush() does the same. The default main
# stack is 1 KB on most boards; 8 KB matches the Arduino loop task this mirrors.
CONFIG_MAIN_STACK_SIZE=8192

# The serial relay shares the console UART with every log line. Minimal mode prints in the
# caller's context instead of from a deferred log thread that flushes whenever it next runs,
# which is what would otherwise land a log line in the middle of a relay request.
CONFIG_LOG=y
CONFIG_LOG_MODE_MINIMAL=y

# Reboot on a fatal error rather than halting, so the next boot can report it. Zephyr halts
# by default, which leaves a field device dead and silent until someone power-cycles it.
CONFIG_REBOOT=y
CONFIG_RESET_ON_FATAL_ERROR=y
```

## wifi.conf
```kconfig
# sentry-micro — zephyr_basic, WiFi build
#
# Merged on top of prj.conf when selected, so the serial-relay build is untouched by any of
# it: the WiFi driver alone adds a 51 KB heap pool, and mbedTLS another 60 KB.
#
#     west build ... -- -DEXTRA_CONF_FILE=wifi.conf
#
# The application owns the network stack; sentry-micro only uses it. Every option here is
# one this sample needs, and the module's Kconfig selects none of them.

# The TLS handshake runs on the caller's thread, here main: mbedTLS's RSA verify and ECDHE
# key exchange go several KB deep, on top of the 2 KB envelope the caller already holds.
# 16 KB is a starting point with margin, not a measured minimum.
CONFIG_MAIN_STACK_SIZE=16384

# IPv4 over the ESP32's own WiFi, with an address from DHCP. The driver selects its L2 and
# the management API but not the IP stack itself.
CONFIG_NETWORKING=y
CONFIG_NET_IPV4=y
CONFIG_NET_IPV6=n
CONFIG_NET_TCP=y
CONFIG_NET_UDP=y
CONFIG_NET_DHCPV4=y
CONFIG_WIFI=y

# Rejoin the access point on its own after a drop, instead of staying off the air until the
# next reboot. The transport reports "no route" in the meantime.
CONFIG_ESP32_WIFI_STA_RECONNECT=y

# Packet and buffer counts from Zephyr's own WiFi sample (samples/net/wifi/shell); the
# defaults are sized for small links and run short during a TLS handshake.
CONFIG_NET_PKT_RX_COUNT=10
CONFIG_NET_PKT_TX_COUNT=10
CONFIG_NET_BUF_RX_COUNT=20
CONFIG_NET_BUF_TX_COUNT=20
CONFIG_NET_MAX_CONTEXTS=10

# BSD-style sockets, which the transport and SNTP are written against, and a DNS resolver
# for the ingest host. The DNS servers come from the DHCP lease.
CONFIG_NET_SOCKETS=y
CONFIG_DNS_RESOLVER=y

# TLS sockets: the stack performs the handshake inside connect() and encrypts every send.
CONFIG_NET_SOCKETS_SOCKOPT_TLS=y

# Ingest negotiates TLS 1.2 with ECDHE-RSA-AES128-GCM-SHA256 behind an RSA certificate
# chain signed with SHA-256, so this one suite, and the SHA-256 it selects, is all that is
# compiled in. Not MBEDTLS_HASH_ALL_ENABLED, as Zephyr's TLS samples use: it drags in MD5 and
# SHA-1, which nothing here needs, and Kconfig warns about MD5 on every build.
CONFIG_MBEDTLS_CIPHERSUITE_TLS_ECDHE_RSA_WITH_AES_128_GCM_SHA256=y

# Ingest closes a handshake that does not name the host it wants (SNI): without this every
# send fails before a certificate is even seen.
CONFIG_MBEDTLS_SSL_SERVER_NAME_INDICATION=y

# The bundled root certificate is PEM, and mbedTLS reads only DER without this.
CONFIG_MBEDTLS_PEM_PARSE_C=y

# Incoming records must hold the server's certificate chain in one piece, about 3 KB for
# ingest; the 1500-byte default cannot. Outgoing records only need to carry the request,
# which the transport writes in pieces no larger than this.
CONFIG_MBEDTLS_SSL_IN_CONTENT_LEN=7168
CONFIG_MBEDTLS_SSL_OUT_CONTENT_LEN=4096

# mbedTLS allocates its contexts and record buffers from a heap of its own. The default is
# 512 bytes, enough for nothing; 60000 is the figure Zephyr's TLS samples use.
CONFIG_MBEDTLS_ENABLE_HEAP=y
CONFIG_MBEDTLS_HEAP_SIZE=60000

# Wall-clock time from the network, so events, logs and metrics carry real timestamps.
CONFIG_SNTP=y
```

## usb_serial.overlay
```dts
/*
 * Console on the ESP32-S3's native USB-Serial-JTAG instead of uart0.
 *
 * For boards whose only USB connector is the chip's own, with no external USB-to-UART bridge
 * on uart0; the relay then runs on the same port the firmware is flashed through. Select it
 * at build time:
 *
 *     west build ... -- -DEXTRA_DTC_OVERLAY_FILE=usb_serial.overlay
 *
 * Note that the chip re-enumerates on every reset, so the host loses and regains the device
 * node around each one: scripts/serial_relay.py waits for the port to come back, and main.c
 * holds the boot event until the host has had time to reopen it.
 */

/ {
	chosen {
		zephyr,console = &usb_serial;
		zephyr,shell-uart = &usb_serial;
	};
};

&usb_serial {
	status = "okay";
};
```

## src/main.c
```c
/*
 * sentry-micro — zephyr_basic
 *
 * The Zephyr counterpart of examples/wifi_basic's boot and crash paths: initialise
 * sentry-micro from a DSN, print what the SDK worked out about this boot — the ingest
 * endpoint, the device id, and why the chip came up — then report either the crash the
 * previous boot died of, with its backtrace, or else this boot as one event.
 *
 * Two ways to reach Sentry, chosen when the firmware is built. With SENTRY_MICRO_WIFI_SSID in
 * the environment (and wifi.conf), the board joins that network, sets its clock over SNTP and
 * posts straight to ingest over HTTPS. Without it, it reaches Sentry through the laptop it is
 * plugged into, which runs scripts/serial_relay.py on the same UART this console uses. See
 * README.md for the build, flash and relay commands, and for what is not done yet.
 */

#include <stdio.h>
#include <string.h>

#include <zephyr/devicetree.h>
#include <zephyr/kernel.h>
#include <zephyr/sys/printk.h>

#include <sentry_micro.h>

#if defined(WIFI_SSID)
#    include <time.h> /* struct timespec, gmtime(); <zephyr/sys/clock.h> does not include it */

#    include <zephyr/net/net_if.h>
#    include <zephyr/net/net_mgmt.h>
#    include <zephyr/net/sntp.h>
#    include <zephyr/net/wifi_mgmt.h>
#    include <zephyr/sys/clock.h>

#    include <transport/zephyr/sentry_transport_wifi.h>
#else
#    include <transport/zephyr/sentry_transport_serial.h>
#endif

#ifndef SENTRY_DSN
#    define SENTRY_DSN "https://examplePublicKey@o0.ingest.sentry.io/0"
#endif

/* Identifies this build in Sentry. Set SENTRY_MICRO_RELEASE in the environment to override. */
#ifndef SENTRY_RELEASE
#    define SENTRY_RELEASE "sentry-micro-example@" SENTRY_MICRO_VERSION
#endif

/* -DSENTRY_DEMO_CRASH=1 to crash deliberately once the boot event is out, and report it
 * on the next boot. */
#ifndef SENTRY_DEMO_CRASH
#    define SENTRY_DEMO_CRASH 0
#endif

/*
 * On the chip's native USB-Serial-JTAG (usb_serial.overlay) the device re-enumerates on every
 * reset, and anything written before the host has reopened the port is dropped by the driver.
 * Hold the boot report until the host has had time to: a USB enumeration plus the relay's
 * reopen poll is well under this.
 */
#if DT_HAS_CHOSEN(zephyr_console) && DT_NODE_EXISTS(DT_NODELABEL(usb_serial))                      \
    && DT_SAME_NODE(DT_CHOSEN(zephyr_console), DT_NODELABEL(usb_serial))
#    define CONSOLE_SETTLE_MS 3000
#else
#    define CONSOLE_SETTLE_MS 0
#endif

#if defined(WIFI_SSID)
/* An open network when no password was given. */
#    ifndef WIFI_PASSWORD
#        define WIFI_PASSWORD ""
#    endif

/* Association, the WPA handshake and a DHCP lease, which a slow router takes most of. */
#    define WIFI_CONNECT_TIMEOUT_MS 30000
/* SNTP is one UDP exchange, and a lost answer is ordinary; each try costs at most this. */
#    define TIME_SYNC_TIMEOUT_MS 5000
#    define TIME_SYNC_ATTEMPTS 3
#    define TIME_SYNC_SERVER "pool.ntp.org"

/* File scope, not a local: the SDK stores a pointer to the transport inside it. */
static sentry_wifi_transport_t wifi_transport;

static struct net_mgmt_event_callback wifi_callback;
static K_SEM_DEFINE(wifi_connected, 0, 1);
static int wifi_connect_status;
#    define NO_ROUTE_HINT "no route (is WiFi up?)"
#else
/* File scope, not a local: the SDK stores a pointer to the transport inside it. */
static sentry_serial_transport_t serial_transport;
#    define NO_ROUTE_HINT "no route (is scripts/serial_relay.py running?)"
#endif

/* The SDK's own narration, through the same console as everything else. */
static void printk_logger(const char *message) { printk("[sentry] %s\n", message); }

static void print_sentry_state(void)
{
    const sentry_device_info_t *dev = sentry_get_device_info();
    const sentry_dsn_t *dsn = sentry_get_dsn();

    printk("\n");
    printk("── sentry-micro ──────────────────────────────\n");
    printk("sdk           : %s %s\n", SENTRY_MICRO_SDK_NAME, sentry_sdk_version());
    printk("enabled       : %s\n", sentry_is_enabled() ? "yes" : "no");
    printk("release       : %s\n", SENTRY_RELEASE);
    printk("ingest host   : %s (tls: %s)\n", dsn->host, dsn->is_secure ? "yes" : "no");
    printk("envelope url  : %s\n", sentry_get_envelope_url());
    printk("── device ────────────────────────────────────\n");
    printk("chip          : %s rev %u, %u core(s)\n", dev->chip_model, (unsigned)dev->chip_revision,
        (unsigned)dev->cpu_cores);
    printk("device id     : %s\n", dev->device_id);
    printk("zephyr        : %s\n", dev->sdk_version);
    printk("reset reason  : %s%s\n", sentry_reset_reason_name(dev->reset_reason),
        sentry_reset_reason_is_crash(dev->reset_reason) ? "  <- previous boot crashed" : "");
    printk("──────────────────────────────────────────────\n");
    printk("\n");
}

/** Human-readable name for a delivery result, for the console. */
static const char *send_result_name(sentry_send_result_t result)
{
    switch (result) {
    case SENTRY_SEND_OK:
        return "delivered";
    case SENTRY_SEND_UNAVAILABLE:
        return NO_ROUTE_HINT;
    case SENTRY_SEND_REJECTED:
        return "rejected (do not retry)";
    case SENTRY_SEND_RATE_LIMITED:
        return "rate limited";
    case SENTRY_SEND_ERROR:
    default:
        return "error";
    }
}

#if defined(WIFI_SSID)
/*
 * Runs on the network management thread. The connect outcome is handed to main, which prints
 * it, so its console lines come out in order with the rest of the boot.
 */
static void wifi_event(struct net_mgmt_event_callback *cb, uint64_t event, struct net_if *iface)
{
    ARG_UNUSED(iface);
    if (event == NET_EVENT_WIFI_CONNECT_RESULT) {
        const struct wifi_status *status = (const struct wifi_status *)cb->info;
        wifi_connect_status = status ? status->status : -1;
        k_sem_give(&wifi_connected);
    } else if (event == NET_EVENT_WIFI_DISCONNECT_RESULT) {
        /* After a connect: CONFIG_ESP32_WIFI_STA_RECONNECT rejoins on its own, and until it
         * does the transport reports "no route". */
        printk("[wifi] disconnected\n");
    }
}

/**
 * Join WIFI_SSID and wait for an address.
 *
 * Under CONFIG_WIFI_STA_AUTO_DHCPV4 (the default) the ESP32 driver starts DHCP itself and
 * raises the connect result only once the lease is bound, so success here means the board has
 * an address and DNS servers, not just an association.
 */
static bool wifi_connect(void)
{
    struct net_if *iface = net_if_get_first_wifi();
    if (!iface) {
        printk("[wifi] no WiFi interface in this build\n");
        return false;
    }

    net_mgmt_init_event_callback(&wifi_callback, wifi_event,
        NET_EVENT_WIFI_CONNECT_RESULT | NET_EVENT_WIFI_DISCONNECT_RESULT);
    net_mgmt_add_event_callback(&wifi_callback);

    struct wifi_connect_req_params params;
    memset(&params, 0, sizeof(params));
    params.ssid = (const uint8_t *)WIFI_SSID;
    params.ssid_length = (uint8_t)strlen(WIFI_SSID);
    params.psk = (const uint8_t *)WIFI_PASSWORD;
    params.psk_length = (uint8_t)strlen(WIFI_PASSWORD);
    params.security = params.psk_length ? WIFI_SECURITY_TYPE_PSK : WIFI_SECURITY_TYPE_NONE;
    params.channel = WIFI_CHANNEL_ANY;
    params.band = WIFI_FREQ_BAND_UNKNOWN;
    params.mfp = WIFI_MFP_OPTIONAL;
    /* The wait below is the bound that matters; the ESP32 driver does not read this. */
    params.timeout = SYS_FOREVER_MS;

    printk("[wifi] connecting to \"%s\" ...\n", WIFI_SSID);
    int64_t started = k_uptime_get();
    int rc = net_mgmt(NET_REQUEST_WIFI_CONNECT, iface, &params, sizeof(params));
    if (rc != 0) {
        printk("[wifi] connect request refused (%d)\n", rc);
        return false;
    }

    /*
     * One request, several results. The first join right after a flash came back as a
     * failure within a second on the bench; with CONFIG_ESP32_WIFI_STA_RECONNECT the driver
     * then keeps trying on its own and raises another result when it gets through, while a
     * second request in the meantime is refused with -EALREADY. So a failure here means "not
     * yet": keep waiting on the same request until the deadline.
     */
    for (;;) {
        int64_t remaining = WIFI_CONNECT_TIMEOUT_MS - (k_uptime_get() - started);
        if (remaining <= 0 || k_sem_take(&wifi_connected, K_MSEC(remaining)) != 0) {
            printk("[wifi] not connected after %ums\n", (unsigned)WIFI_CONNECT_TIMEOUT_MS);
            return false;
        }
        if (wifi_connect_status == WIFI_STATUS_CONN_SUCCESS) {
            break;
        }
        printk("[wifi] join failed (status %d) after %ums; the driver retries\n",
            wifi_connect_status, (unsigned)(k_uptime_get() - started));
    }

    char ip[NET_IPV4_ADDR_LEN] = "?";
    const struct net_in_addr *addr = net_if_ipv4_get_global_addr(iface, NET_ADDR_PREFERRED);
    if (addr) {
        net_addr_ntop(NET_AF_INET, addr, ip, sizeof(ip));
    }
    printk("[wifi] connected: ip=%s in %ums\n", ip, (unsigned)(k_uptime_get() - started));
    return true;
}

/**
 * Set the wall clock from SNTP.
 *
 * Not needed for TLS here: mbedTLS is built without date checks (MBEDTLS_HAVE_TIME_DATE is
 * off), so the certificate verifies with the clock at 1970. It is what gives events a real
 * timestamp, and what logs and metrics wait for before they are sent at all. Failure is
 * therefore not fatal; the events go out with ingest's receive time instead.
 */
static bool sync_time(void)
{
    struct sntp_time now;
    int rc = -1;
    for (unsigned attempt = 1; attempt <= TIME_SYNC_ATTEMPTS && rc < 0; attempt++) {
        rc = sntp_simple(TIME_SYNC_SERVER, TIME_SYNC_TIMEOUT_MS, &now);
        if (rc < 0) {
            printk("[time] SNTP attempt %u of %u failed (%d)\n", attempt,
                (unsigned)TIME_SYNC_ATTEMPTS, rc);
        }
    }
    if (rc < 0) {
        printk("[time] no time from SNTP: events go out without a timestamp\n");
        return false;
    }

    struct timespec ts;
    ts.tv_sec = (time_t)now.seconds;
    /* The fraction is in units of 2^-32 s. */
    ts.tv_nsec = (long)(((uint64_t)now.fraction * 1000000000ull) >> 32);
    rc = sys_clock_settime(SYS_CLOCK_REALTIME, &ts);
    if (rc < 0) {
        printk("[time] could not set the clock (%d)\n", rc);
        return false;
    }

    time_t seconds = (time_t)now.seconds;
    const struct tm *utc = gmtime(&seconds);
    printk("[time] synced from %s: %04d-%02d-%02d %02d:%02d:%02d UTC\n", TIME_SYNC_SERVER,
        utc->tm_year + 1900, utc->tm_mon + 1, utc->tm_mday, utc->tm_hour, utc->tm_min, utc->tm_sec);
    return true;
}
#endif

/**
 * Report the crash the previous boot recorded, if there is one.
 *
 * Returns true if a crash was reported, so the caller knows not to report the same boot a
 * second time as a plain "Device booted: panic".
 */
static bool report_crash(void)
{
    char event_id[SENTRY_MICRO_EVENT_ID_LEN];
    sentry_event_t event;
    sentry_coredump_t crash;

    if (!sentry_event_prepare(&event, event_id)) {
        return false;
    }
    /* `crash` has to outlive the event, which points into it — hence both being locals of
     * this function rather than the event owning a copy. */
    if (!sentry_event_attach_coredump(&event, &crash)) {
        return false;
    }

    char message[128];
    const char *type = crash.exception_type[0] ? crash.exception_type : "Panic";
    if (crash.task_name[0]) {
        snprintf(message, sizeof(message), "%s in thread %s", type, crash.task_name);
    } else {
        snprintf(message, sizeof(message), "%s", type);
    }
    event.message = message;

    printk("\n");
    printk("── crash recovered from the previous boot ────\n");
    printk("exception     : %s\n", crash.exception_type);
    printk("thread        : %s\n", crash.task_name);
    printk("pc            : 0x%08x\n", (unsigned)crash.exception_pc);
    if (crash.exception_addr_valid) {
        printk("accessing     : 0x%08x\n", (unsigned)crash.exception_addr);
    }
    printk("backtrace     : %u frames%s\n", (unsigned)crash.frame_count,
        crash.truncated ? " (truncated)" : "");
    for (uint32_t i = 0; i < crash.frame_count; i++) {
        printk("  #%u 0x%08x\n", (unsigned)i, (unsigned)crash.frames[i]);
    }
    printk("──────────────────────────────────────────────\n");

    /* Same 2 KB as the SDK's own envelope buffer, and on this stack for the same reason: no
     * heap on the crash path. CONFIG_MAIN_STACK_SIZE has the room. */
    char envelope[2048];
    size_t needed = sentry_envelope_write(envelope, sizeof(envelope), &event);
    if (needed == 0 || needed >= sizeof(envelope)) {
        printk("[sentry] crash envelope needs %u bytes\n", (unsigned)needed);
        return true;
    }

    sentry_response_t response = sentry_send_envelope((const uint8_t *)envelope, needed);
    printk("[sentry] crash report: %s (http %u)\n", send_result_name(response.result),
        (unsigned)response.http_status);

    /* Erase only once the envelope is somewhere durable — delivered, or in the buffer.
     * Erasing on a plain failure would throw away the crash we just recovered. */
    if (response.result == SENTRY_SEND_OK || sentry_buffered_count() > 0) {
        sentry_coredump_erase();
        printk("[sentry] crash record erased\n");
    } else {
        printk("[sentry] crash record kept for the next boot\n");
    }
    printk("[sentry] crash event %s\n", event_id);
    return true;
}

static void report_boot(void)
{
    const sentry_device_info_t *dev = sentry_get_device_info();
    bool crashed = sentry_reset_reason_is_crash(dev->reset_reason);

    char message[96];
    snprintf(
        message, sizeof(message), "Device booted: %s", sentry_reset_reason_name(dev->reset_reason));

    /* A crash is fatal; an ordinary power-on is just news. Getting this wrong would either
     * page someone for a normal reboot or bury a real panic. */
    sentry_response_t response
        = sentry_capture_message(crashed ? SENTRY_LEVEL_FATAL : SENTRY_LEVEL_INFO, message);

    printk(
        "[sentry] %s (http %u", send_result_name(response.result), (unsigned)response.http_status);
    if (response.retry_after_ms > 0) {
        printk(", retry after %ums", (unsigned)response.retry_after_ms);
    }
    printk(")\n");
}

#if SENTRY_DEMO_CRASH
/*
 * A deliberate null-pointer store, three calls deep, as in the Arduino example.
 *
 * `noinline` on each level so the optimiser cannot collapse them into one frame. The address
 * is read from a volatile rather than written as a constant 0: the Zephyr SDK's GCC proves a
 * store to a literal null pointer is undefined, treats the whole call chain as unreachable,
 * and deletes the call to demo_crash_outer() — the board then carries on instead of
 * crashing. A volatile read is a value it cannot know. The next boot reports it through
 * report_crash(), with this chain in its backtrace.
 */
static volatile uintptr_t demo_crash_address = 0;

static void __attribute__((noinline)) demo_crash_innermost(void)
{
    volatile uint32_t *nowhere = (volatile uint32_t *)demo_crash_address;
    *nowhere = 0xdeadbeef;
}

static void __attribute__((noinline)) demo_crash_middle(void) { demo_crash_innermost(); }

static void __attribute__((noinline)) demo_crash_outer(void) { demo_crash_middle(); }
#endif

int main(void)
{
    printk("\n\nsentry-micro zephyr_basic example\n");

    /* Before anything else that might crash: the reset reason read here belongs to the
     * *previous* boot, so the earlier this runs, the more of the firmware it covers. */
    sentry_set_logger(printk_logger);

    sentry_options_t options;
    sentry_options_defaults(&options);
    options.dsn = SENTRY_DSN;
    options.release = SENTRY_RELEASE;
    options.environment = "development";
    options.board = CONFIG_BOARD;
    options.debug = true;

    if (!sentry_init(&options)) {
        /* A bad DSN disables the SDK rather than half-configuring it; the firmware carries
         * on regardless. Crash reporting must never be load-bearing. */
        printk("[sentry] init failed — check SENTRY_MICRO_DSN\n");
    }

    if (CONSOLE_SETTLE_MS > 0) {
        k_sleep(K_MSEC(CONSOLE_SETTLE_MS));
    }

    print_sentry_state();

#if defined(WIFI_SSID)
    /* Network and clock before anything is reported, so the first event already carries a
     * real timestamp. A failed connect is not fatal: the transport then reports "no route",
     * and with no offline storage the event is dropped; a recovered crash record is kept for
     * the next boot in that case. */
    bool time_synced = false;
    if (wifi_connect()) {
        time_synced = sync_time();
    }
    /* NULL: trust the DigiCert root bundled with sentry-micro, which ingest chains to. */
    sentry_set_transport(sentry_wifi_transport_init(&wifi_transport, NULL, 0));
    printk("[sentry] transport: wifi, HTTPS straight to ingest (certificate check %s)\n",
        IS_ENABLED(CONFIG_SENTRY_MICRO_WIFI_TLS_VERIFY) ? "on" : "OFF");
    /* Session updates wait for the date, and the main loop's first flush is ten seconds
     * away; a demo crash comes sooner than that. Flushing now sends the last boot's close
     * and this boot's start the moment they can go, ahead of the crash report. 0: nothing
     * from an offline buffer, which this sample does not have anyway. The SDK's own log
     * prints one "[sentry] session ..." line per update. */
    if (time_synced) {
        sentry_flush(0);
    }
#else
    /* NULL: the console UART, which is the one the relay script is attached to. */
    sentry_set_transport(sentry_serial_transport_init(&serial_transport, NULL, 0));
    printk("[sentry] transport: serial relay on the console UART\n");
#endif

    /* A recovered crash is the more interesting event, and reporting both on the same boot
     * would double up. */
    if (!report_crash()) {
        report_boot();
    }

#if SENTRY_DEMO_CRASH
    /* Only when this boot did not itself follow a crash, so one power-on produces one
     * crash-and-report cycle rather than a loop. The fatal-error hook marks its reboot as a
     * panic, so the boot after the demo crash reads `panic` and stops here. */
    if (!sentry_reset_reason_is_crash(sentry_get_device_info()->reset_reason)) {
        printk("\n[demo] crashing deliberately in 3s ...\n");
        /* Recorded and never flushed, so they are still in the log ring when the board
         * crashes. The next boot reports them as the crash event's breadcrumbs, the trail
         * that led to it, rather than as ordinary logs. */
        sentry_log(SENTRY_LEVEL_INFO, "demo: boot reported, crashing in 3 s");
        k_sleep(K_SECONDS(3));
        sentry_log(SENTRY_LEVEL_WARNING, "demo: calling demo_crash_outer()");
        demo_crash_outer();
    }
#endif

    while (true) {
        /* On an interval, not in a tight loop: with no route a send blocks for the
         * transport's whole timeout. With no offline storage registered this only moves
         * metrics and logs, and those wait for a wall clock, which only the WiFi build sets. */
        k_sleep(K_SECONDS(10));
        sentry_flush(2);
    }
    return 0;
}
```
